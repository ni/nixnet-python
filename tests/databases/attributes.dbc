VERSION ""

NS_ :

BS_:

BU_: ECU2 ECU1

BO_ 1 Msg2: 8 Vector__XXX
 SG_ StatSig : 16|8@1- (1,0) [0|0] "" Vector__XXX
 SG_ ModDepSig m0 : 8|8@1- (1,0) [0|0] "" Vector__XXX
 SG_ MuxSig M : 0|8@1- (1,0) [0|0] "" Vector__XXX

BO_ 0 Msg1: 8 Vector__XXX
 SG_ Sig2 : 8|8@1- (1,0) [0|0] "" Vector__XXX
 SG_ Sig1 : 0|8@1- (1,0) [0|0] "" Vector__XXX

EV_ ev1: 0 [0|0] "" 0 1 DUMMY_NODE_VECTOR0 Vector__XXX;

BA_DEF_ BO_  "MsgAttr4" ENUM  "1","2","3";
BA_DEF_ BO_  "MsgAttr3" STRING ;
BA_DEF_ BO_  "MsgAttr2" FLOAT 0 0;
BA_DEF_ BU_  "EcuAttr1" STRING ;
BA_DEF_  "NetworkAttr1" STRING ;
BA_DEF_ SG_  "SigAttr1" INT 0 0;
BA_DEF_ BO_  "MsgAttr1" INT 0 0;
BA_DEF_  "BusType" STRING ;
BA_DEF_DEF_  "MsgAttr4" "2";
BA_DEF_DEF_  "MsgAttr3" "DefaultMsgAttr3String";
BA_DEF_DEF_  "MsgAttr2" -11.1;
BA_DEF_DEF_  "EcuAttr1" "xEcu1";
BA_DEF_DEF_  "NetworkAttr1" "abc";
BA_DEF_DEF_  "SigAttr1" 1;
BA_DEF_DEF_  "MsgAttr1" 2;
BA_DEF_DEF_  "BusType" "CAN";
BA_ "EcuAttr1" BU_ ECU2 "xEcu2-Set";
BA_ "MsgAttr4" BO_ 1 0;
BA_ "MsgAttr3" BO_ 1 "MsgAttr3String";
BA_ "MsgAttr2" BO_ 1 -23.33;
BA_ "MsgAttr1" BO_ 1 22;
BA_ "SigAttr1" SG_ 0 Sig2 11;
VAL_ 0 Sig1 4 "High" 0 "Zero" -10 "Low" ;
